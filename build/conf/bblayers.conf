## build/conf/bblayers.conf
```bitbake
# LAYER_CONF_VERSION is increased each time build/conf/bblayers.conf
# changes incompatibly
LCONF_VERSION = "7"

BBPATH = "${TOPDIR}"
BBFILES ?= ""

MIONBASE = "${@os.path.abspath(os.path.join("${TOPDIR}", os.pardir))}"

BBLAYERS = " \
  ${MIONBASE}/openembedded-core/meta \
  ${MIONBASE}/meta-openembedded/meta-oe \
  ${MIONBASE}/meta-openembedded/meta-networking \
  ${MIONBASE}/meta-openembedded/meta-python \
  ${MIONBASE}/meta-openembedded/meta-filesystems \
  ${MIONBASE}/meta-virtualization \
  ${MIONBASE}/meta-security/meta-tpm \
  ${MIONBASE}/meta-yocto/meta-yocto-bsp \
  ${MIONBASE}/meta-sca \
  ${MIONBASE}/meta-python2 \
  ${MIONBASE}/meta-intel \
  ${MIONBASE}/meta-mion \
  ${MIONBASE}/meta-mion-bsp/meta-mion-${VENDOR} \
"
```
